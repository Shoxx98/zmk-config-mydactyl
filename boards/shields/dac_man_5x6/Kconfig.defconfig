## boards/shields/dac_man_5x6/Kconfig.defconfig
```kconfig
if SHIELD_DAC_MAN_5X6_LEFT

config ZMK_KEYBOARD_NAME
    default "Dac-Man-5x6-L"

config ZMK_SPLIT_BLE_ROLE_CENTRAL
    default y

endif

if SHIELD_DAC_MAN_5X6_RIGHT

config ZMK_KEYBOARD_NAME
    default "Dac-Man-5x6-R"

endif

if SHIELD_DAC_MAN_5X6_LEFT || SHIELD_DAC_MAN_5X6_RIGHT

config ZMK_SPLIT
    default y
endif

config ZMK_UNICODE_TAP_MS
    int "Time to wait (in milliseconds) between the press and release of each key in the unicode sequence."
    default 10


config ZMK_UNICODE_WAIT_MS
    int "Time to wait (in milliseconds) between unicode tapping keys in the unicode sequence."
    default 100
```

## config/west.yml
```yaml
manifest:
  remotes:
    - name: zmkfirmware
      url-base: https://github.com/zmkfirmware
    - name: Shoxx98
      url-base: https://github.com/Shoxx98
  projects:
    - name: zmk
      remote: zmkfirmware
      revision: v0.3
      import: app/west.yml
    - name: zmk-unicode
      remote: Shoxx98
      revision: v0.3 
  self:
    path: config
```
